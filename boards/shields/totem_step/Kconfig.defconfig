## boards/shields/totem_step/Kconfig.defconfig
```kconfig
if SHIELD_TOTEM_STEP_DONGLE

config ZMK_KEYBOARD_NAME
    default "Zodify"

config ZMK_SPLIT_ROLE_CENTRAL
    default y

endif

if SHIELD_TOTEM_STEP_LEFT || SHIELD_TOTEM_STEP_RIGHT || SHIELD_TOTEM_STEP_DONGLE

config ZMK_SPLIT
    default y

config ZMK_POINTING
    default y

endif

if SHIELD_TOTEM_STEP_LEFT || SHIELD_TOTEM_STEP_RIGHT

config I2C
    default y

endif
```

## boards/shields/zodify/Kconfig.defconfig
```kconfig
if SHIELD_ZODIFY_DONGLE

config ZMK_KEYBOARD_NAME
    default "Zodify"

config ZMK_SPLIT_ROLE_CENTRAL
    default y

endif

if SHIELD_ZODIFY_LEFT || SHIELD_ZODIFY_RIGHT || SHIELD_ZODIFY_DONGLE

config ZMK_SPLIT
    default y

config ZMK_POINTING
    default y

endif

if SHIELD_ZODIFY_LEFT || SHIELD_ZODIFY_RIGHT

if ZMK_DISPLAY

config I2C
    default y

config SSD1306
    default y

endif # ZMK_DISPLAY

endif
```

## config/west.yml
```yaml
manifest:
  remotes:
    - name: zmkfirmware
      url-base: https://github.com/zmkfirmware
    # support nice_oled and nice_epaper
    - name: mctechnology17
      url-base: https://github.com/mctechnology17
    - name: janpfischer
      url-base: https://github.com/janpfischer
    - name: AYM1607
      url-base: https://github.com/AYM1607
  projects:
    - name: zmk
      remote: zmkfirmware
      revision: main
      import: app/west.yml
    # support nice_oled and nice_epaper
    - name: zmk-nice-oled
      remote: mctechnology17
      revision: main
    - name: zmk-dongle-screen
      remote: janpfischer
      revision: main
    - name: zmk-driver-azoteq-iqs5xx
      remote: AYM1607
      revision: main
  self:
    path: config
```
